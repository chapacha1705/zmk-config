/ {
    chosen {
        zmk,kscan = &kscan_direct;
    };

    kscan_direct: kscan_direct {
        compatible = "zmk,kscan-gpio-direct";
        label = "KSCAN_DIRECT";
        input-gpios
            = <&gpio0 6 (GPIO_ACTIVE_LOW | GPIO_PULL_UP)>;
    };
};
